## Config.in
```kconfig
source "$BR2_EXTERNAL_EMBETRIX_PATH/package/stm32mp-sign-tool/Config.in.host"
source "$BR2_EXTERNAL_EMBETRIX_PATH/package/minimal-qt5/Config.in"
source "$BR2_EXTERNAL_EMBETRIX_PATH/package/qstopwatch/Config.in"
source "$BR2_EXTERNAL_EMBETRIX_PATH/package/qt6connectivity/Config.in"
source "$BR2_EXTERNAL_EMBETRIX_PATH/package/ausweisapp/Config.in"
```

## configs/qemux86-64_defconfig
```kconfig
BR2_x86_64=y
BR2_TOOLCHAIN_BUILDROOT_CXX=y
BR2_GCC_ENABLE_OPENMP=y
BR2_GCC_ENABLE_GRAPHITE=y
BR2_PACKAGE_HOST_GDB=y
BR2_PACKAGE_HOST_GDB_PYTHON3=y
BR2_DL_DIR="$(BR2_EXTERNAL_EMBETRIX_PATH)/dl"
BR2_CCACHE=y
BR2_CCACHE_DIR="$(BR2_EXTERNAL_EMBETRIX_PATH)/cache"
BR2_REPRODUCIBLE=y
BR2_SSP_ALL=y
BR2_INIT_SYSTEMD=y
BR2_ROOTFS_DEVICE_TABLE_SUPPORTS_EXTENDED_ATTRIBUTES=y
BR2_ROOTFS_OVERLAY="$(BR2_EXTERNAL_EMBETRIX_PATH)/board/qemu-x86_64/rootfs-overlay"
BR2_LINUX_KERNEL=y
BR2_LINUX_KERNEL_USE_ARCH_DEFAULT_CONFIG=y
BR2_LINUX_KERNEL_CONFIG_FRAGMENT_FILES="$(BR2_EXTERNAL_EMBETRIX_PATH)/board/qemu-x86_64/linux.fragment"
BR2_LINUX_KERNEL_NEEDS_HOST_LIBELF=y
BR2_LINUX_KERNEL_EXT_FBTFT=y
BR2_PACKAGE_BUSYBOX_CONFIG_FRAGMENT_FILES="$(BR2_EXTERNAL_EMBETRIX_PATH)/board/qemu-x86_64/busybox.fragment"
BR2_PACKAGE_KEXEC=y
BR2_PACKAGE_KEXEC_ZLIB=y
BR2_PACKAGE_STRACE=y
BR2_PACKAGE_BMAP_WRITER=y
BR2_PACKAGE_DOSFSTOOLS=y
BR2_PACKAGE_DOSFSTOOLS_FSCK_FAT=y
BR2_PACKAGE_DOSFSTOOLS_MKFS_FAT=y
BR2_PACKAGE_E2TOOLS=y
BR2_PACKAGE_LINUX_FIRMWARE=y
BR2_PACKAGE_CRYPTSETUP=y
BR2_PACKAGE_LIBOPENSSL_BIN=y
BR2_PACKAGE_JSON_FOR_MODERN_CPP=y
BR2_PACKAGE_YAML_CPP=y
BR2_PACKAGE_ELFUTILS=y
BR2_PACKAGE_AVAHI=y
BR2_PACKAGE_AVAHI_DAEMON=y
BR2_PACKAGE_AVAHI_LIBDNSSD_COMPATIBILITY=y
BR2_PACKAGE_OPENSSH=y
BR2_PACKAGE_SOCAT=y
BR2_PACKAGE_TCPDUMP=y
BR2_PACKAGE_EFIBOOTMGR=y
BR2_PACKAGE_UTIL_LINUX_BINARIES=y
BR2_PACKAGE_UTIL_LINUX_HWCLOCK=y
BR2_PACKAGE_UTIL_LINUX_NOLOGIN=y
BR2_PACKAGE_UTIL_LINUX_PARTX=y
BR2_TARGET_ROOTFS_CPIO_DRACUT=y
BR2_TARGET_ROOTFS_CPIO_DRACUT_MODULES="$(BR2_EXTERNAL_EMBETRIX_PATH)/board/qemu-x86_64/dracut/modules.d"
BR2_TARGET_ROOTFS_CPIO_DRACUT_CONF_FILES="$(BR2_EXTERNAL_EMBETRIX_PATH)/board/qemu-x86_64/dracut/dracut.conf"
BR2_TARGET_ROOTFS_CPIO_GZIP=y
BR2_TARGET_ROOTFS_EXT2=y
BR2_TARGET_ROOTFS_EXT2_4=y
BR2_TARGET_ROOTFS_EXT2_SIZE="600M"
BR2_TARGET_ROOTFS_INITRAMFS=y
BR2_TARGET_ROOTFS_SQUASHFS=y
BR2_TARGET_ROOTFS_SQUASHFS4_XZ=y
BR2_PACKAGE_HOST_BMAP_TOOLS=y
BR2_PACKAGE_HOST_BMAP_WRITER=y
BR2_PACKAGE_HOST_CMAKE=y
BR2_PACKAGE_HOST_CRYPTSETUP=y
BR2_PACKAGE_HOST_ENVIRONMENT_SETUP=y
BR2_PACKAGE_HOST_GENEXT2FS=y
BR2_PACKAGE_HOST_GENIMAGE=y
BR2_PACKAGE_HOST_MKPASSWD=y
BR2_PACKAGE_HOST_PKGCONF=y
BR2_PACKAGE_HOST_PYTHON_LXML=y
BR2_PACKAGE_HOST_PYTHON3_BZIP2=y
BR2_PACKAGE_HOST_PYTHON3_XZ=y
BR2_PACKAGE_HOST_PYTHON3_CURSES=y
BR2_PACKAGE_HOST_PYTHON3_SSL=y
BR2_PACKAGE_HOST_QEMU=y
BR2_PACKAGE_HOST_QEMU_SYSTEM_MODE=y
BR2_PACKAGE_HOST_QEMU_LINUX_USER_MODE=y
BR2_PACKAGE_HOST_SQUASHFS=y
BR2_PACKAGE_HOST_UBOOT_TOOLS=y
BR2_PACKAGE_HOST_UUU=y
BR2_PACKAGE_HOST_ZIP=y
BR2_PACKAGE_HOST_ZSTD=y
BR2_PACKAGE_AUSWEISAPP=y
```

## configs/stm32mp157f_dk2_defconfig
```kconfig
BR2_arm=y
BR2_cortex_a7=y
BR2_PACKAGE_HOST_LINUX_HEADERS_CUSTOM_6_6=y
BR2_TOOLCHAIN_BUILDROOT_CXX=y
BR2_DL_DIR="$(BR2_EXTERNAL_EMBETRIX_PATH)/dl"
BR2_CCACHE=y
BR2_CCACHE_DIR="$(BR2_EXTERNAL_EMBETRIX_PATH)/cache"
BR2_REPRODUCIBLE=y
BR2_TARGET_GENERIC_GETTY_PORT="ttySTM0"
BR2_ROOTFS_OVERLAY="$(BR2_EXTERNAL_EMBETRIX_PATH)/board/stmicroelectronics/stm32mp157f-dk2/overlay/"
BR2_ROOTFS_POST_IMAGE_SCRIPT="$(BR2_EXTERNAL_EMBETRIX_PATH)/board/stmicroelectronics/stm32mp157f-dk2/post-image.sh"
BR2_LINUX_KERNEL=y
BR2_LINUX_KERNEL_CUSTOM_TARBALL=y
BR2_LINUX_KERNEL_CUSTOM_TARBALL_LOCATION="$(call github,STMicroelectronics,linux)v6.6-stm32mp-r2.tar.gz"
BR2_LINUX_KERNEL_PATCH="$(BR2_EXTERNAL_EMBETRIX_PATH)/board/stmicroelectronics/stm32mp157f-dk2/patches/linux"
BR2_LINUX_KERNEL_DEFCONFIG="multi_v7"
BR2_LINUX_KERNEL_CONFIG_FRAGMENT_FILES="$(LINUX_DIR)/arch/arm/configs/fragment-01-multiv7_cleanup.config $(LINUX_DIR)/arch/arm/configs/fragment-02-multiv7_addons.config $(BR2_EXTERNAL_EMBETRIX_PATH)/board/stmicroelectronics/stm32mp157f-dk2/linux.config"
BR2_LINUX_KERNEL_CUSTOM_LOGO_PATH="$(BR2_EXTERNAL_EMBETRIX_PATH)/board/stmicroelectronics/stm32mp157f-dk2/embetrix.png"
BR2_LINUX_KERNEL_DTS_SUPPORT=y
BR2_LINUX_KERNEL_INTREE_DTS_NAME="st/stm32mp157f-dk2"
BR2_LINUX_KERNEL_INSTALL_TARGET=y
BR2_LINUX_KERNEL_NEEDS_HOST_OPENSSL=y
BR2_LINUX_KERNEL_NEEDS_HOST_PYTHON3=y
BR2_TARGET_ROOTFS_EXT2=y
BR2_TARGET_ROOTFS_EXT2_4=y
BR2_TARGET_ROOTFS_EXT2_SIZE="120M"
# BR2_TARGET_ROOTFS_TAR is not set
BR2_TARGET_ARM_TRUSTED_FIRMWARE=y
BR2_TARGET_ARM_TRUSTED_FIRMWARE_CUSTOM_TARBALL=y
BR2_TARGET_ARM_TRUSTED_FIRMWARE_CUSTOM_TARBALL_LOCATION="$(call github,STMicroelectronics,arm-trusted-firmware)v2.10-stm32mp-r2.tar.gz"
BR2_TARGET_ARM_TRUSTED_FIRMWARE_PLATFORM="stm32mp1"
BR2_TARGET_ARM_TRUSTED_FIRMWARE_FIP=y
BR2_TARGET_ARM_TRUSTED_FIRMWARE_BL31=y
BR2_TARGET_ARM_TRUSTED_FIRMWARE_BL32_OPTEE=y
BR2_TARGET_ARM_TRUSTED_FIRMWARE_UBOOT_AS_BL33=y
BR2_TARGET_ARM_TRUSTED_FIRMWARE_UBOOT_BL33_IMAGE="u-boot-nodtb.bin"
BR2_TARGET_ARM_TRUSTED_FIRMWARE_ADDITIONAL_VARIABLES="STM32MP_SDMMC=1 AARCH32_SP=optee DTB_FILE_NAME=stm32mp157f-dk2.dtb BL33_CFG=$(BINARIES_DIR)/u-boot.dtb STM32MP1_OPTEE_IN_SYSRAM=1 OPENSSL_DIR=$(BR2_HOST_DIR)"
BR2_TARGET_ARM_TRUSTED_FIRMWARE_IMAGES="fip.bin *.stm32"
BR2_TARGET_ARM_TRUSTED_FIRMWARE_NEEDS_DTC=y
BR2_TARGET_OPTEE_OS=y
BR2_TARGET_OPTEE_OS_CUSTOM_TARBALL=y
BR2_TARGET_OPTEE_OS_CUSTOM_TARBALL_LOCATION="$(call github,STMicroelectronics,optee_os)4.0.0-stm32mp-r2.tar.gz"
BR2_TARGET_OPTEE_OS_NEEDS_DTC=y
BR2_TARGET_OPTEE_OS_NEEDS_PYTHON_CRYPTOGRAPHY=y
BR2_TARGET_OPTEE_OS_PLATFORM="stm32mp1"
BR2_TARGET_OPTEE_OS_PLATFORM_FLAVOR="157F_DK2"
BR2_TARGET_OPTEE_OS_ADDITIONAL_VARIABLES="CFG_EMBED_DTB_SOURCE_FILE=stm32mp157f-dk2.dts CFG_STM32MP15=y CFG_DRAM_SIZE=0x20000000 CFG_STM32MP1_OPTEE_IN_SYSRAM=y"
BR2_TARGET_UBOOT=y
BR2_TARGET_UBOOT_BUILD_SYSTEM_KCONFIG=y
BR2_TARGET_UBOOT_CUSTOM_TARBALL=y
BR2_TARGET_UBOOT_CUSTOM_TARBALL_LOCATION="$(call github,STMicroelectronics,u-boot)v2023.10-stm32mp-r2.tar.gz"
BR2_TARGET_UBOOT_BOARD_DEFCONFIG="stm32mp15"
BR2_TARGET_UBOOT_NEEDS_PYLIBFDT=y
BR2_TARGET_UBOOT_NEEDS_OPENSSL=y
# BR2_TARGET_UBOOT_FORMAT_BIN is not set
BR2_TARGET_UBOOT_FORMAT_DTB=y
BR2_TARGET_UBOOT_FORMAT_CUSTOM=y
BR2_TARGET_UBOOT_FORMAT_CUSTOM_NAME="u-boot-nodtb.bin"
BR2_TARGET_UBOOT_CUSTOM_MAKEOPTS="DEVICE_TREE=stm32mp157f-dk2"
BR2_PACKAGE_HOST_GENIMAGE=y
BR2_PACKAGE_HOST_STM32MP_SIGN_TOOL=y
BR2_PACKAGE_QSTOPWATCH=y
```

## package/ausweisapp/Config.in
```kconfig
config BR2_PACKAGE_AUSWEISAPP
    bool "ausweisapp"
    depends on BR2_INSTALL_LIBSTDCPP
    select BR2_PACKAGE_QT6
    select BR2_PACKAGE_QT6BASE
    select BR2_PACKAGE_QT6BASE_CONCURRENT
    select BR2_PACKAGE_QT6DECLARATIVE_QUICK
    select BR2_PACKAGE_QT6SCXML
    select BR2_PACKAGE_QT6LANGUAGESERVER
    select BR2_PACKAGE_QT6WEBSOCKETS
    select BR2_PACKAGE_QT6DECLARATIVE
    select BR2_PACKAGE_QT6BASE_FONTCONFIG
    select BR2_PACKAGE_QT6BASE_GUI
    select BR2_PACKAGE_QT6BASE_WIDGETS
    select BR2_PACKAGE_FONT_AWESOME
    select BR2_PACKAGE_QT6SVG
    select BR2_PACKAGE_QT6CONNECTIVITY
    select BR2_PACKAGE_NEARD
    select BR2_PACKAGE_OPENSSL
    select BR2_PACKAGE_OPENSC
    select BR2_PACKAGE_HOST_QT6TOOLS
    select BR2_PACKAGE_HOST_QT6TOOLS_LINGUIST_TOOLS
    select BR2_PACKAGE_HOST_QT6SHADERTOOLS
    help
      ausweisapp

comment "ausweisapp needs a toolchain w/ C++"
    depends on !BR2_INSTALL_LIBSTDCPP
```

## package/minimal-qt5/Config.in
```kconfig
config BR2_PACKAGE_MINIMAL_QT5
    bool "minimal-qt5"
    depends on BR2_INSTALL_LIBSTDCPP
    select BR2_PACKAGE_QT5
    select BR2_PACKAGE_QT5BASE
    select BR2_PACKAGE_QT5DECLARATIVE
    select BR2_PACKAGE_QT5TOOLS
    select BR2_PACKAGE_QT5BASE_FONTCONFIG
    select BR2_PACKAGE_QT5BASE_GUI
    select BR2_PACKAGE_QT5BASE_WIDGETS
    select BR2_PACKAGE_FONT_AWESOME
    help
      minimal-qt5

comment "minimal-qt5 needs a toolchain w/ C++"
    depends on !BR2_INSTALL_LIBSTDCPP
```

## package/qstopwatch/Config.in
```kconfig
config BR2_PACKAGE_QSTOPWATCH
    bool "qstopwatch"
    depends on BR2_INSTALL_LIBSTDCPP
    select BR2_PACKAGE_QT6
    select BR2_PACKAGE_QT6BASE
    select BR2_PACKAGE_QT6DECLARATIVE_QUICK
    select BR2_PACKAGE_QT6DECLARATIVE
    select BR2_PACKAGE_QT6BASE_FONTCONFIG
    select BR2_PACKAGE_QT6BASE_GUI
    select BR2_PACKAGE_QT6SVG
    select BR2_PACKAGE_HOST_QT6TOOLS
    select BR2_PACKAGE_HOST_QT6TOOLS_LINGUIST_TOOLS
    select BR2_PACKAGE_HOST_QT6SHADERTOOLS
    select BR2_PACKAGE_FONT_AWESOME
    help
      qstopwatch

comment "qstopwatch needs a toolchain w/ C++"
    depends on !BR2_INSTALL_LIBSTDCPP
```

## package/qt6connectivity/Config.in
```kconfig
config BR2_PACKAGE_QT6CONNECTIVITY
	bool "qt6connectivity"
	depends on BR2_PACKAGE_NEARD || BR2_PACKAGE_BLUEZ5_UTILS
	select BR2_PACKAGE_QT6BASE_NETWORK
	select BR2_PACKAGE_QT6BASE_DBUS
	help
	  Qt is a cross-platform application and UI framework for
	  developers using C++.

	  Qt Connectivity module provides support for Bluetooth/NFC
	  peripherials.

	  https://doc.qt.io/qt-6/qtbluetooth-index.html
	  https://doc.qt.io/qt-6/qtnfc-index.html

comment "qt6connectivity needs neard and/or bluez5_utils"
	depends on !BR2_PACKAGE_NEARD && !BR2_PACKAGE_BLUEZ5_UTILS
```

## package/stm32mp-sign-tool/Config.in.host
```kconfig
config BR2_PACKAGE_HOST_STM32MP_SIGN_TOOL
	bool "host stm32mp-sign-tool"
	help
	  stm32mp-sign-tool is an utility for 
	  signing and verifying firmware images 
	  compatible with STM32MP MPUs

	  https://github.com/embetrix/stm32mp-sign-tool
```
